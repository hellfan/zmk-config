## boards/shields/scylla/Kconfig.defconfig
```kconfig
if SHIELD_SCYLLA_LEFT

config ZMK_SCYLLA
    default "Scylla"

config ZMK_SPLIT_ROLE_CENTRAL
    default y

endif

if SHIELD_SCYLLA_LEFT || SHIELD_SCYLLA_RIGHT

config ZMK_SPLIT
    default y

if LVGL

config LV_Z_VDB_SIZE
    default 64

config LV_Z_DPI
    default 148

config LV_Z_BITS_PER_PIXEL
    default 1

choice LV_COLOR_DEPTH
    default LV_COLOR_DEPTH_1
endchoice

endif # LVGL

endif
```
